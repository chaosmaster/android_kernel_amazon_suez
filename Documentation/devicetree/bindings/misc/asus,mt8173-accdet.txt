## Documentation/devicetree/bindings/misc/asus,mt8173-accdet.txt
```
MT8173 headset detection driver

Required properties:
- compatible: asus,mt8173-accdet
- interrupt-parent: should be the phandle for the interrupt controller
- interrupts: Should contain interrupt number of jack detection
- gpios: list of gpio phandles to get headset state

Optional properties:
- pinctrl-names: initialize pin state for interruption
- headset-mode-setting: define debounce time in mt6391 pmic accdet
- headset-four-key-threshold: define four voltage threshold to detect four key buttons
- accdet_voltage_mode: select accdet voltage mode(0:1.9V, 1:2.8V)

Example:

asus_mt8173_accdet {
	compatible = "asus,mt8173-accdet";
	interrupt-parent = <&pio>;
	interrupts = <97 IRQ_TYPE_EDGE_RISING>,
		    <37 IRQ_TYPE_EDGE_FALLING>;
	gpios = <&pio 97 0>,
		<&pio 37 0>;
	pinctrl-names = "uart-default", "jack-default";
	pinctrl-0 = <&uart_int_pin_default>;
	pinctrl-1 = <&jack_int_pin_default>;
	headset-mode-setting = <0x100 0x100 1 0x1F0 0x200 0x200 0x20>;
	headset-four-key-threshold = <0 59 128 192 350>;
	accdet_voltage_mode = <0>;
}
```

## Documentation/devicetree/bindings/nfc/mt6605_gpio.txt
```
Bindings for nfc connected to I2C lines

Required properties:
- compatible : "mediatek,nfc-gpio-v2"

Examples:

static struct platform_driver mtk_nfc_platform_driver = {
	.probe = mt_nfc_probe,
	.remove = mt_nfc_remove,
	.driver = {
		   .name = I2C_ID_NAME,
		   .owner = THIS_MODULE,
		   .of_match_table = nfc_dev_of_match,
		   },
};
```

## Documentation/devicetree/bindings/nfc/mt6605_i2c.txt
```
Bindings for nfc connected to I2C lines

Required properties:
- compatible : "mediatek,nfc"

Examples:

static struct i2c_driver mt6605_dev_driver = {
	.id_table = mt6605_id,
	.probe = mt6605_probe,
	.remove = mt6605_remove,
	.driver = {
		   .name = "mt6605",
		   .owner = THIS_MODULE,
		   .of_match_table = nfc_switch_of_match,
		   },
};
```

## drivers/input/touchscreen/mediatek/Kconfig
```kconfig
#
# Touchscreen driver configuration
#
menuconfig INPUT_TOUCHSCREEN
	bool "Touchscreens"
	help
	  Say Y here, and a list of supported touchscreens will be displayed.
	  This option doesn't affect the kernel.

	  If unsure, say Y.

if INPUT_TOUCHSCREEN

config TOUCHSCREEN_MTK
	bool "MediaTek Touch Panel Driver"
	help
	  Say Y here if you have MediaTek touch panel.

	  If unsure, say N.

	  To compile this dirver as a module, choose M here: the
	  module will be called.

config TOUCHSCREEN_MTK_FT5726
	tristate "FT5726 Touchscreen"
	help
	  Say Y here if you have FT5726 touchscreen,
	  connected to your system.
          To compile this dirver as a module, choose M here: the
          module will be called.

config SHOW_TOUCH_VENDOR
	tristate "FT5726 show touch vendor"
	help
	  Say Y here if FT5726 have show touch vendor feature,
	  connected to your system.
          To compile this dirver as a module, choose M here: the
          module will be called.

config TOUCHSCREEN_MTK_SYNAPTICS_I2C_RMI4
	tristate "Synaptics DSX I2C touchscreen"
	depends on I2C
	help
	  Say Y here if you have a Synaptics DSX I2C touchscreen
	  connected to your system.

	  If unsure, say N.

	  To compile this driver as a module, choose M here: the
	  module will be called synaptics_i2c_rmi4.

source "drivers/input/touchscreen/mediatek/synaptics_i2c_rmi4/Kconfig"

config TOUCHSCREEN_GESTURE_WAKEUP
	bool "Touch Screen Gesture Wakeup support"
	default n
	help
	  Say Y here if you support Touch Screen Gesture Wakeup
	  If unsure, say N.

endif
```

## drivers/misc/mediatek/accdet/Kconfig
```kconfig
config MTK_ACCDET
	depends on !ASUS_MTK_ACCDET
	tristate "MediaTek ACCDET driver"
	---help---

	  ACCDET driver support for MediaTek SOC

	  If you want to use MediaTek ACCDET driver,
	  say Y or M here.

	  If unsure, say N.

config ACCDET_EINT
	depends on MTK_ACCDET
	tristate "MediaTek ACCDET driver"
	---help---

	  ACCDET EINT support for MediaTek SOC

	  If you want to use MediaTek ACCDET EINT from PMIC ACCDET itself,
	  say Y or M here.

	  If unsure, say N.

config ACCDET_EINT_IRQ
	depends on MTK_ACCDET
	tristate "MediaTek ACCDET driver"
	---help---

	  ACCDET EINT support for MediaTek SOC

	  If you want to use MediaTek ACCDET EINT from AP GPIO,
	  say Y or M here.

	  If unsure, say N.

config ACCDET_PIN_SWAP
	depends on MTK_ACCDET
	tristate "MediaTek ACCDET driver"
	---help---

	  ACCDET_PIN_SWAP support for MediaTek SOC

	  If you want to use MediaTek ACCDET PIN SWAP,
	  say Y or M here.

	  If unsure, say N.

config ACCDET_PIN_RECOGNIZATION
	depends on MTK_ACCDET
	tristate "MediaTek ACCDET driver"
	---help---

	  ACCDET_PIN_RECOGNIZATION support for MediaTek SOC

	  If you want to use MediaTek ACCDET PIN RECOGNIZATION,
	  say Y or M here.

	  If unsure, say N.

config FOUR_KEY_HEADSET
	depends on MTK_ACCDET
	tristate "MediaTek ACCDET driver"
	---help---

	  FOUR_KEY_HEADSET support for MediaTek SOC

	  If you want to use MediaTek ACCDET four key headset,
	  say Y or M here.

	  If unsure, say N.

config HEADSET_SUPPORT_FIVE_POLE
	depends on MTK_ACCDET
	tristate "MediaTek ACCDET driver"
	---help---

	  HEADSET_SUPPORT_FIVE_POLE support for MediaTek SOC

	  If you want to use MediaTek ACCDET five pole headset,
	  say Y or M here.

	  If unsure, say N.

config TS3A225E_ACCDET
	depends on MTK_ACCDET
	tristate "MediaTek ACCDET driver"
	---help---

	  TS3A225E support for MediaTek SOC

	  If you want to use TS3A225E
	  say Y or M here.

	  If unsure, say N.

config ACCDET_TO_UART
	tristate "MediaTek ACCDET driver"
	---help---

	  ACCDET_TO_UART support for MediaTek SOC

	  If you want to use MediaTek ACCDET to uart
	  say Y or M here.

	  If unsure, say N.

config ASUS_MT8173_ACCDET
	depends on !MTK_ACCDET
	tristate "Asus MT8173 Accdet driver"
	---help---

	MT8173 Accdet driver support for MediaTek SOC

	If you want to use Asus MT8173 Accdet driver,
	say Y or M here.

	If unsure, say N.

config ACCDET_OMTP_CTIA_SWITCH
	tristate "MediaTek ACCDET driver"
	---help---

	Switch IC - support for MediaTek SOC

	If you want to use CTIA/OMTP Switch IC,
	say Y or M here.

	If unsure, say N.
```

## drivers/misc/mediatek/accelerometer/bma253/Kconfig
```kconfig
config MTK_BMA253
	bool "MTK_BMA53 for MediaTek package"
	default n
	help
	  It support different accelerometer sensor.
          If this option is set,
	  it will support
          MTK_BMA253 Accelerometer.

config BMA253_LOWPASS
	bool "MTK_BMA253 for Mediatek package"
	default n
	help
	Say Y here if you have MTK_BMA253 touch panel BMA253_LOWPASS.

	If unsure, say N.

	To compile this dirver as a module, choose M here: the
	module will be called.

config CUSTOM_KERNEL_SENSORHUB
	bool "MTK_BMA253 for Mediatek package"
	default n
	help
	Say Y here if you have MTK_BMA253 touch panel CUSTOM_KERNEL_SENSORHUB.

	If unsure, say N.

	To compile this dirver as a module, choose M here: the
	module will be called.
```

## drivers/misc/mediatek/alsps/LTR559/Kconfig
```kconfig
config MTK_LTR559
	bool "LTR559 for MediaTek package"
	default n
	help
	It support different type sensor
	in this platform. If this option
	is set, it will support ambient
	and light sensor LTR559.
```

## drivers/misc/mediatek/alsps/stk3x1x/Kconfig
```kconfig
config MTK_STK3X1X
	bool "STK3X1X for MediaTek package"
	default n
	help
	It support different type sensor
	in this platform. If this option
	is set, it will support ambient
	and light sensor STK3X1X.
```

## drivers/misc/mediatek/etm/Kconfig
```kconfig
config MTK_ETM
        bool "Support For Embedded Trace Macrocell"
        default y
        help
```

## drivers/misc/mediatek/met/Kconfig
```kconfig
menu "MET"

config MTK_MET
	tristate "MET core driver"
	default n
	---help---
	  The core module of MTK MET profiling tool.
	  We can use the config to define MET core driver.
	  It's depend on MTK_FTRACE

config MTK_MET_PLF
	tristate "MET platform-related driver"
	depends on MTK_MET
	default n
	---help---
	  The platform module of MTK MET profiling tool.
	  We can use the config to define MET platform driver.
	  It's depend on MTK_MET

endmenu
```

## drivers/misc/mediatek/performance/Kconfig
```kconfig
config MTK_PERFMGR_TOUCH_BOOST
	tristate "touch boost in performance manager"
	default n
	help
	  touch boost in performance manager

config MTK_FLIPER
	bool "enable emi bandwidth kicker for vcore dvfs"
	help
	  Say y here to enable emi bandiwidth kicker for vcore dvfs
```

## drivers/staging/amazon/Kconfig
```kconfig
menu "Amazon"

config AMAZON
	bool "Amazon Drivers"
	default N
	---help---
	  Enable support for various drivers needed on the Amazon Fire OS platform

if AMAZON

config AMAZON_KLOG_CONSOLE
	bool "Amazon Kernel Log Console"
	depends on ANDROID_LOGGER
	default N
	---help---
	  provide the kernel log console which will rewrite the kernel message to Android Logger buffer.

config AMAZON_LOGD
    bool "Amazon Logd"
    depends on ANDROID_LOGGER
    default N
    ---help---
      device uses logd for logging

config AMAZON_SIGN_OF_LIFE
	bool "Amazon Sign of Life"
	help
	enable the life cycle metrics to log device boot and shutdown information

config AMAZON_SIGN_OF_LIFE_MTK
	bool "Amazon Sign of Life MTK platform implementation"
	help
	enable the life cycle metrics to log device boot and shutdown information on MTK Platform

config AMAZON_POWEROFF_LOG
	bool "Long press key power off log"
	default N
	help
	enable Long press key power off log

config BISCUIT
	bool "Biscuit MTK platform project"
	help
	isolate amazon biscuit changes for MTK Platform
endif # if AMAZON

endmenu
```

## sound/soc/mediatek/Kconfig
```kconfig
config SND_SOC_MT8173
    tristate

config SND_SOC_MT8173_MT6391_MACH
    tristate "ASoC Audio driver for MT8173 with MT6391 codec"
    depends on ARCH_MT8173
    select SND_SOC_MT8173
    select SND_SOC_MT6391
    help
        This adds audio driver for MT8173 platform with the MT6391 audio codec.

config SND_SOC_MT8173_MT6391_abc123_MACH
    tristate "ASoC Audio driver for MT8173 abc123 board"
    depends on ARCH_MT8173
    select SND_SOC_MT8173
    select SND_SOC_MT6391
    help
        This adds audio driver for MT8173 abc123 board
        with the MT6391 audio codec.
        It depends on ARCH_MT8173.
        Select Y to include related drivers.

config SND_SOC_MT8173_MT6391_SUEZ_MACH
    tristate "ASoC Audio driver for MT8173 Suez board"
    depends on ARCH_MT8173 && I2C
    select SND_SOC_MT8173
    select SND_SOC_MT6391
    select SND_SOC_RT5514
    help
        This adds audio driver for MT8173 Suez board
        with the MT6391 audio codec.
        It depends on ARCH_MT8173.
        Select Y to include related drivers.
```
